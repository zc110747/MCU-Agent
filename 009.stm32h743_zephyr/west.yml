## 009.stm32h743_zephyr/west.yml
```yaml
manifest:
  remotes:
    - name: zephyr
      url-base: https://github.com/zephyrproject-rtos
  defaults:
    remote: zephyr
  self:
    path: .
  projects:
    - name: zephyr
      path: zephyr/zephyr
      west-commands: scripts/west-commands.yml
    - name: hal_stm32
      path: zephyr/modules/hal/stm32
    - name: cmsis
      path: zephyr/modules/hal/cmsis
    - name: fatfs
      path: zephyr/modules/fs/fatfs
    - name: lvgl
      path: zephyr/modules/lib/gui/lvgl
```

## 103.stm32f429_zephyr/boards/stm32f429ig/Kconfig.stm32f429ig
```kconfig
# Copyright (c) 2026
# SPDX-License-Identifier: Apache-2.0

config BOARD_STM32F429IG
	select SOC_STM32F429XX
```

## 203.esp32s3_wireless_debug/components/debug_engine/Kconfig
```kconfig
menu "Debug Engine"

    config WIRELESS_DEBUG_RESERVE_RAM
        bool "Reserve PSRAM pool for wireless-debug transport"
        default y
        depends on SPIRAM
        help
            Carve out a static pool from external PSRAM at boot and never free
            it. Intended for the future DAP-over-WiFi packet transport buffers
            (so a large inbound DAP stream never competes with internal DRAM
            used by the IRAM bit-bang code and the USB/WiFi stacks).

    config WIRELESS_DEBUG_RESERVE_RAM_SIZE_KB
        int "Reserved pool size (KB)"
        default 512
        range 64 4096
        depends on WIRELESS_DEBUG_RESERVE_RAM
        help
            Size of the reserved external-PSRAM pool in KB.

endmenu
```

## 203.esp32s3_wireless_debug/components/jtag/Kconfig
```kconfig
menu "JTAG Engine Configuration"

config DEBUG_TDI_GPIO
    int "TDI GPIO number"
    default 7
    range 0 48
    help
        GPIO connected to the target TDI pin. TCK/TMS are shared with the
        SWD engine (SWCLK/SWDIO) and are configured there.

config DEBUG_TDO_GPIO
    int "TDO GPIO number"
    default 8
    range 0 48
    help
        GPIO connected to the target TDO pin.

config DEBUG_NTRST_GPIO
    int "nTRST GPIO number (-1 = not connected)"
    default 9
    range -1 48
    help
        GPIO connected to the target nTRST pin. Set to -1 if not wired.
        Driven open-drain (never pushed high), internal pull-up enabled.

config DEBUG_JTAG_DEFAULT_CLOCK_HZ
    int "Default JTAG clock (Hz)"
    default 1000000

config DEBUG_JTAG_MAX_CLOCK_HZ
    int "Maximum JTAG clock (Hz)"
    default 8000000
    range 100000 20000000
    help
        Soft cap applied by DAP_SWJ_Clock. Bit-banged JTAG on ESP32-S3 has
        been verified up to this frequency; raise only after testing.

endmenu
```

## 203.esp32s3_wireless_debug/components/swd/Kconfig
```kconfig
menu "SWD Engine Configuration"

config DEBUG_SWDIO_GPIO
    int "SWDIO GPIO number"
    default 5
    range 0 48
    help
        GPIO connected to the target SWDIO pin (core board header J1).

config DEBUG_SWCLK_GPIO
    int "SWCLK GPIO number"
    default 4
    range 0 48
    help
        GPIO connected to the target SWCLK pin (core board header J1).

config DEBUG_NRESET_GPIO
    int "nRESET GPIO number (-1 = not connected)"
    default 6
    range -1 48
    help
        GPIO connected to the target nRESET pin. Set to -1 if not wired.
        Driven open-drain (never pushed high), internal pull-up enabled.

config DEBUG_SWD_DEFAULT_CLOCK_HZ
    int "Default SWD clock (Hz)"
    default 100000
    help
        Stage-1 bring-up clock. Fix stability at 100 kHz first (connect under
        reset, DPIDR, CTRLSTAT, MEM-AP, DHCSR), then raise step by step
        (400k / 1M / 2M / 5M). Never sacrifice 100k/400k stability for speed.

config DEBUG_SWD_TRACE
    bool "Enable SWD connect/diagnostic trace logs"
    default n
    help
        When enabled, logs the SWD clock, JTAG->SWD switch, DPIDR, CTRLSTAT,
        AP IDR and per-stage connect results. Never affects the bit-level
        hot path (swd_transfer stays IRAM + log-free).

config DEBUG_SWD_MAX_CLOCK_HZ
    int "Maximum SWD clock (Hz)"
    default 8000000
    range 100000 20000000
    help
        Soft cap applied by DAP_SWJ_Clock. Bit-banged SWD on ESP32-S3 has
        been verified up to this frequency; raise only after testing.

endmenu
```

## 203.esp32s3_wireless_debug/components/usb_device/Kconfig
```kconfig
menu "Debug Probe USB Configuration"

config DEBUG_PROBE_USB_VID
    hex "USB Vendor ID"
    default 0x303A

config DEBUG_PROBE_USB_PID
    hex "USB Product ID"
    default 0x8502

config DEBUG_PROBE_USB_MANUFACTURER
    string "USB Manufacturer string"
    default "ESP32-S3 Debug Probe"

config DEBUG_PROBE_USB_PRODUCT
    string "USB Product string"
    default "ESP32-S3 CMSIS-DAP Debug Probe"
    help
        Host tools (Keil / OpenOCD / pyOCD) match CMSIS-DAP devices by the
        "CMSIS-DAP" substring in this string or in the interface string.

endmenu

menu "Debug Probe General Configuration"

config DEBUG_PROBE_LOG_LEVEL
    int "Debug probe log level (0=ERROR..5=VERBOSE)"
    default 3
    help
        Applied to probe component log tags at boot.

config DEBUG_ENABLE_USB
    bool "Enable USB CMSIS-DAP interface"
    default y

config DEBUG_ENABLE_UART
    bool "Enable UART bridge (V4 feature, reserved)"
    default n

config DEBUG_ENABLE_WIFI
    bool "Enable Wi-Fi debug server (V2 feature, reserved)"
    default n

config DEBUG_PROBE_SELFTEST
    bool "Run debug self-test at boot (connect + identify target)"
    default n

endmenu
```

## 203.esp32s3_wireless_debug/components/wifi_dap/Kconfig
```kconfig
menu "Wi-Fi CMSIS-DAP Transport"

config WIFI_DAP_USB_WAIT_MS
    int "USB host detection window before starting the SoftAP (ms)"
    default 3000
    range 0 60000
    help
        At boot the probe waits up to this long for a USB host to attach and
        enumerate the HID interface. If a host shows up inside the window the
        SoftAP is NEVER started and the probe stays in USB mode, because
        Wi-Fi RF activity on ESP32-S3 corrupts USB OTG HID transfers.
        Only when no host ever appears does the probe fall back to the
        wireless transport (SoftAP + TCP 50000).
        Raise this value if your host enumerates slowly; set 0 to skip the
        wait and start Wi-Fi immediately.

endmenu
```
